## external_tlp_test/Config.in
```kconfig
comment "|   .-<-- A --<-.          "
comment "|  /             \\         "
comment "| S --<-- B --<-- C        "
comment "|  \\               \\       "
comment "|   `-<-- D --<-----<-- F  "
comment "| S: skeleton              "
comment "| F: target-finalize       "

source "$BR2_EXTERNAL_TLP_TEST_PATH/package/tlp_pkga/Config.in"
source "$BR2_EXTERNAL_TLP_TEST_PATH/package/tlp_pkgb/Config.in"
source "$BR2_EXTERNAL_TLP_TEST_PATH/package/tlp_pkgc/Config.in"
source "$BR2_EXTERNAL_TLP_TEST_PATH/package/tlp_pkgd/Config.in"
```

## external_tlp_test/package/tlp_pkga/Config.in
```kconfig
config BR2_PACKAGE_TLP_PKGA
	bool "pkgA"
	help
	  TLP test package A

if BR2_PACKAGE_TLP_PKGA
config BR2_PACKAGE_TLP_PKGA_INSTALL_PKGAB
	bool "install pkgab file"
	help
	  Install pkgab file
endif
```

## external_tlp_test/package/tlp_pkgb/Config.in
```kconfig
config BR2_PACKAGE_TLP_PKGB
	bool "pkgB"
	help
	  TLP test package B

if BR2_PACKAGE_TLP_PKGB
config BR2_PACKAGE_TLP_PKGB_INSTALL_PKGAB
	bool "install pkgab file"
	help
	  Install pkgab file
endif
```

## external_tlp_test/package/tlp_pkgc/Config.in
```kconfig
config BR2_PACKAGE_TLP_PKGC
	bool "pkgC"
	select BR2_PACKAGE_TLP_PKGA
	select BR2_PACKAGE_TLP_PKGB
	help
	  TLP test package C (depends on A and B)

if BR2_PACKAGE_TLP_PKGC
config BR2_PACKAGE_TLP_PKGC_OVERWRITE_PKGA
	bool "overwrite pkgA"
	help
	  TLP test package C overwrite file from pkgA

config BR2_PACKAGE_TLP_PKGC_INSTALL_PKGCD
	bool "install pkgcd file"
	help
	  Install pkgcd file
endif
```

## external_tlp_test/package/tlp_pkgd/Config.in
```kconfig
config BR2_PACKAGE_TLP_PKGD
	bool "pkgD"
	help
	  TLP test package D

if BR2_PACKAGE_TLP_PKGD
config BR2_PACKAGE_TLP_PKGD_INSTALL_PKGCD
	bool "install pkgcd file"
	help
	  Install pkgcd file
endif
```
